/*
HAGIWO MOD2 HiHat Ver1.1 - With LED envelope display
white and blue noise base HiHat.
LED brightness follows the envelope shape when triggered.
Button has dual function: short press for manual trigger, long press (>500ms) to toggle noise type.

--Pin assign---
POT1     A0       Decay time
POT2     A1       Decay curve
POT3     A2       BPF freq
IN1      GPIO7    Trig in
IN2      GPIO0    Accent (Volume decreases when HIGH)
CV       A2       Shared with POT3
OUT      GPIO1    Audio output
BUTTON   GPIO6    Manual Trig (short) / Noise select (long press)
LED      GPIO5    WS2812B — blue = blue noise, white = white noise, green flash on trigger (80 ms)
EEPROM    N/A


CC0 1.0 Universal (CC0 1.0) Public Domain Dedication
You can copy, modify, distribute and perform the work, even for commercial purposes, all without asking permission.

Most of the source code was generated by AI.
Although the code has been tested, it may still exhibit unstable behavior or contain incorrect comments.

*/

#include <Arduino.h>
#include "hardware/pwm.h"
#include "hardware/irq.h"
#include <math.h>

// ── WS2812B ───────────────────────────────────────────────────────────────────
#include <Adafruit_NeoPixel.h>
#define LED_PIN   5
#define LED_COUNT 1
Adafruit_NeoPixel led(LED_COUNT, LED_PIN, NEO_GRB + NEO_KHZ800);

bool     ledTrigOn    = false;
uint32_t ledTrigOffAt = 0;
// ──────────────────────────────────────────────────────────────────────────────

/********************  === Core constants ===  *******************************************/
const float    SYS_CLOCK = 150000000.0f;
const float    AUDIO_FS  = SYS_CLOCK / 4096;
const uint32_t TABLE_SZ  = 30000;

const float    PWM_FS       = 1023.0f;
const float    PWM_MID      = PWM_FS / 2.0f;
const float    AMP_SCALE    = 3.5f;
const float    MASTER_ATTEN = 0.8f;

const uint16_t FADE_IN_SMP  = 73;
const uint16_t FADE_OUT_SMP = 40;

/********************  === ADC ===  ******************************************************/
const uint8_t  ADC_RES_BITS = 10;
const uint16_t ADC_MAX_VAL  = (1 << ADC_RES_BITS) - 1;

/********************  === Buffers ===  **************************************************/
float    noiseTbl[TABLE_SZ];
int16_t  outHH[TABLE_SZ];

/********************  === Playback state / control ===  *********************************/
volatile bool     playingHH = false;
volatile uint32_t idxHH     = 0;

volatile float decayBase  = 5.0f;
volatile float decayCurve = 1.0f;
volatile float fc         = 500.0f;

volatile bool  reqTrig   = false;
volatile float volFactor = 1.0f;

volatile uint8_t noiseMode      = 0;   // 0:Blue / 1:White
volatile bool    reqNoiseUpdate = false;

volatile uint32_t buttonPressTime  = 0;
volatile bool     buttonPressed    = false;
volatile uint32_t lastButtonChange = 0;
const uint32_t    LONG_PRESS_MS  = 500;
const uint32_t    DEBOUNCE_MS    = 20;

uint sliceAudio, sliceIRQ;   // sliceLED removed

/********************  === Helpers ===  **************************************************/
inline uint16_t readADC(uint8_t pin){ return analogRead(pin); }

/********************  === Noise generation ===  ****************************************/
void generateBlueNoise(){
  float prev = 2.0f*(rand()/(float)RAND_MAX) - 1.0f;
  noiseTbl[0] = prev * 0.5f;
  for(uint32_t i=1;i<TABLE_SZ;++i){
    float w = 2.0f*(rand()/(float)RAND_MAX) - 1.0f;
    float b = (w - prev) * 0.5f; prev = w;
    noiseTbl[i] = constrain(b, -1.0f, 1.0f);
  }
}

void generateWhiteNoise(){
  for(uint32_t i=0;i<TABLE_SZ;++i)
    noiseTbl[i] = 2.0f*(rand()/(float)RAND_MAX) - 1.0f;
}

void updateNoiseTable(){
  if(noiseMode == 0) generateBlueNoise();
  else               generateWhiteNoise();
}

/********************  === Voice generation ===  ****************************************/
void buildVoice(int16_t* dst, float decayB, float curve, float fcC){
  const float Q = 0.8f;
  float w0    = 2.0f*PI*fcC/AUDIO_FS;
  float sw    = sinf(w0), cw = cosf(w0);
  float alpha = sw/(2.0f*Q);
  float b0 =  Q*alpha, b1 = 0.0f, b2 = -Q*alpha;
  float a0 = 1.0f+alpha, a1 = -2.0f*cw, a2 = 1.0f-alpha;
  float ia0 = 1.0f/a0;
  b0*=ia0; b1*=ia0; b2*=ia0; a1*=ia0; a2*=ia0;

  float x1=0,x2=0,y1=0,y2=0, env=1.0f;
  float expK = expf(-decayB*curve/TABLE_SZ);

  for(uint32_t i=0;i<TABLE_SZ;++i){
    float x0 = noiseTbl[i]*env;
    float y0 = b0*x0 + b1*x1 + b2*x2 - a1*y1 - a2*y2;
    x2=x1; x1=x0; y2=y1; y1=y0;

    float fade = 1.2f;
    if(i < FADE_IN_SMP)                    fade = i/float(FADE_IN_SMP);
    else if(i > TABLE_SZ-FADE_OUT_SMP-1)   fade = (TABLE_SZ-i-1)/float(FADE_OUT_SMP);
    y0 *= fade;

    dst[i] = int16_t(constrain(y0,-1.0f,1.0f)*PWM_MID*MASTER_ATTEN);
    env *= expK;
  }
}

/********************  === PWM IRQ — audio only, no LED ===  ****************************/
void on_pwm_wrap(){
  pwm_clear_irq(sliceIRQ);

  if(!playingHH){
    pwm_set_chan_level(sliceAudio, PWM_CHAN_B, uint16_t(PWM_MID));
    return;
  }

  int32_t mix = outHH[idxHH];
  int32_t val = PWM_MID + int32_t(mix*AMP_SCALE*volFactor);
  if(val<0) val=0; else if(val>1023) val=1023;
  pwm_set_chan_level(sliceAudio, PWM_CHAN_B, uint16_t(val));

  idxHH++;
  if(idxHH >= TABLE_SZ){ playingHH=false; idxHH=0; }
}

/********************  === ISRs ===  *****************************************************/
void triggerISR(){
  volFactor = digitalRead(0) ? 0.5f : 1.0f;
  reqTrig   = true;
}

void buttonISR(){
  uint32_t now = millis();
  if(now - lastButtonChange < DEBOUNCE_MS) return;
  lastButtonChange = now;

  if(digitalRead(6) == LOW){
    buttonPressed   = true;
    buttonPressTime = now;
  } else {
    if(buttonPressed){
      buttonPressed = false;
      uint32_t pressDuration = now - buttonPressTime;

      if(pressDuration < LONG_PRESS_MS){
        volFactor = digitalRead(0) ? 0.5f : 1.0f;
        reqTrig   = true;
      } else {
        noiseMode     ^= 1;
        reqNoiseUpdate = true;
      }
    }
  }
}

/********************  === SETUP ===  ****************************************************/
void setup(){
  analogReadResolution(ADC_RES_BITS);
  randomSeed(analogRead(26));
  updateNoiseTable();

  // ── WS2812B init (replaces pinMode(5,OUTPUT) + LED PWM slice) ─────────────
  led.begin();
  led.setBrightness(180);
  led.setPixelColor(0, led.Color(0, 80, 255));  // boot: blue (blue noise default)
  led.show();
  // ──────────────────────────────────────────────────────────────────────────

  pinMode(1, OUTPUT); gpio_set_function(1, GPIO_FUNC_PWM);
  sliceAudio = pwm_gpio_to_slice_num(1);
  pwm_set_clkdiv(sliceAudio, 1); pwm_set_wrap(sliceAudio, 1023); pwm_set_enabled(sliceAudio, true);

  pinMode(2, OUTPUT); gpio_set_function(2, GPIO_FUNC_PWM);
  sliceIRQ = pwm_gpio_to_slice_num(2);
  pwm_set_clkdiv(sliceIRQ, 1); pwm_set_wrap(sliceIRQ, 4095); pwm_set_enabled(sliceIRQ, true);
  pwm_clear_irq(sliceIRQ); pwm_set_irq_enabled(sliceIRQ, true);
  irq_set_exclusive_handler(PWM_IRQ_WRAP, on_pwm_wrap);
  irq_set_enabled(PWM_IRQ_WRAP, true);

  pinMode(0, INPUT);
  pinMode(7, INPUT); attachInterrupt(digitalPinToInterrupt(7), triggerISR, RISING);
  pinMode(6, INPUT_PULLUP); attachInterrupt(digitalPinToInterrupt(6), buttonISR, CHANGE);
}

/********************  === LOOP ===  *****************************************************/
void loop(){
  float norm0 = 1.0f - (readADC(A0)/float(ADC_MAX_VAL));
  float norm1 = 1.0f - (readADC(A1)/float(ADC_MAX_VAL));
  float norm2 = 1.0f - (readADC(A2)/float(ADC_MAX_VAL));

  decayBase  = 0.1f  +  9.0f * norm0;
  decayCurve = 0.2f  +  5.0f * norm1;
  fc         = 100.0f + 15900.0f * norm2;

  if(reqNoiseUpdate){
    reqNoiseUpdate = false;
    updateNoiseTable();
    // ── Update mode color after long press ──────────────────────────────────
    if(!ledTrigOn){
      led.setPixelColor(0, noiseMode == 0 ? led.Color(0, 80, 255) : led.Color(255, 255, 255));
      led.show();
    }
    // ────────────────────────────────────────────────────────────────────────
  }

  if(reqTrig){
    reqTrig   = false;
    buildVoice(outHH, decayBase, decayCurve, fc);
    idxHH     = 0;
    playingHH = true;

    // ── Green flash 80 ms on trigger ────────────────────────────────────────
    led.setPixelColor(0, led.Color(0, 255, 80));
    led.show();
    ledTrigOn    = true;
    ledTrigOffAt = millis() + 80;
    // ────────────────────────────────────────────────────────────────────────
  }

  // ── Restore mode color after flash ──────────────────────────────────────
  if(ledTrigOn && millis() >= ledTrigOffAt){
    led.setPixelColor(0, noiseMode == 0 ? led.Color(0, 80, 255) : led.Color(255, 255, 255));
    led.show();
    ledTrigOn = false;
  }
  // ──────────────────────────────────────────────────────────────────────────

  delayMicroseconds(500);
}
