/*
HAGIWO MOD2 Clap Ver1.1 - With LED envelope display

  • TR‑808‑style digital hand‑clap: two short gated noise bursts followed by an exponential noise tail
  • LED brightness follows the envelope shape (bursts + decay)
  • 3 potentiometers → live control of BPF Q, decay time and BPF centre frequency
  • Accent input (GPIO0): HIGH = −6 dB (0.5× amplitude)
  • Fixed 3‑burst structure: two 4 ms noise gates spaced 15 ms apart + exponential tail (≤0.60 s)
  • One‑shot voice buffer: 22 000 samples @36.6 kHz (≈0.60 s) held in RAM

  --Pin assign---
POT1     A0       BPF Q (0.5 – 4.0)   — left = wide, right = narrow
POT2     A1       Decay time (20 – 200 ms)
POT3     A2       BPF Fc (50 Hz – 8 kHz)
IN1      GPIO7    External trigger (rising‑edge)
IN2      GPIO0    Accent — HIGH = ‑6 dB (0.5×)
CV       A2       Shared with POT3
BUTTON   GPIO6    Manual trigger (active‑low, pull‑up)
OUT      GPIO1    10‑bit PWM audio output
LED      GPIO5    WS2812B — on for decay duration, color = BPF Fc (warm → cool)
EEPROM    N/A

CC0 1.0 Universal (CC0 1.0) Public Domain Dedication
You can copy, modify, distribute and perform the work, even for commercial purposes, all without asking permission.

Most of the source code was generated by AI.
Although the code has been tested, it may still exhibit unstable behavior or contain incorrect comments.

*/

#include <Arduino.h>
#include "hardware/pwm.h"
#include "hardware/irq.h"
#include <math.h>

// ── WS2812B ───────────────────────────────────────────────────────────────────
#include <Adafruit_NeoPixel.h>
#define LED_PIN   5
#define LED_COUNT 1
Adafruit_NeoPixel led(LED_COUNT, LED_PIN, NEO_GRB + NEO_KHZ800);
// ──────────────────────────────────────────────────────────────────────────────

/**********************  === Core constants ===  *****************************/
const float    SYS_CLOCK = 150000000.0f;
const float    AUDIO_FS  = SYS_CLOCK / 4096.0f;
const uint32_t TABLE_SZ  = 22000;

const float    PWM_FS       = 1023.0f;
const float    PWM_MID      = PWM_FS / 2.0f;
const float    AMP_SCALE    = 3.5f;
const float    MASTER_ATTEN = 0.8f;
const uint16_t FADE_IN_SMP  = 70;
const uint16_t FADE_OUT_SMP = 40;

/**********************  === ADC setup ===  **********************************/
const uint8_t  ADC_RES_BITS = 10;
const uint16_t ADC_MAX_VAL  = (1 << ADC_RES_BITS) - 1;

/**********************  === Buffers / state ===  ****************************/
float   noiseTbl[TABLE_SZ];
int16_t outClap[TABLE_SZ];

volatile bool     playingClap = false;
volatile uint32_t idxClap     = 0;

volatile float    decayMs     = 110.0f;
volatile float    bpfQ        = 2.25f;
volatile float    fc          = 1500.0f;
const   float     DECAY_CURVE = 2.0f;

volatile float    volFactor   = 1.0f;
volatile bool     reqTrig     = false;

// ── LED state (loop only, never touched in ISR) ───────────────────────────────
bool     ledOn    = false;
uint32_t ledOffAt = 0;
// ──────────────────────────────────────────────────────────────────────────────

uint sliceAudio, sliceIRQ;

/**********************  === Helper ===  *************************************/
inline uint16_t readADC(uint8_t pin){ return analogRead(pin); }

/**********************  === Noise table ===  ********************************/
void generateWhiteNoise(){
  for(uint32_t i=0;i<TABLE_SZ;++i)
    noiseTbl[i] = 2.0f*(rand()/(float)RAND_MAX) - 1.0f;
}

/**********************  === Voice builder ===  ******************************/
void buildClap(int16_t* dst, float decay_ms, float fcC, float qVal){
  const float Q  = qVal;
  float w0    = 2.0f * PI * fcC / AUDIO_FS;
  float sw    = sinf(w0), cw = cosf(w0);
  float alpha = sw / (2.0f * Q);
  float b0    =  Q * alpha, b1 = 0.0f, b2 = -Q * alpha;
  float a0    = 1.0f + alpha, a1 = -2.0f * cw, a2 = 1.0f - alpha;
  float ia0   = 1.0f / a0;
  b0*=ia0; b1*=ia0; b2*=ia0; a1*=ia0; a2*=ia0;

  const uint8_t  BURSTS         = 3;
  const uint32_t PULSE_INTERVAL = uint32_t(0.015f * AUDIO_FS);
  const uint32_t BURST_LEN      = uint32_t(0.004f * AUDIO_FS);

  const float tau_s = decay_ms / 1000.0f;
  const float expK  = expf(-1.0f / (tau_s * AUDIO_FS));

  uint32_t nextOn  = 0;
  uint32_t nextOff = BURST_LEN;
  uint8_t  current    = 0;
  bool     gateOn     = false;
  bool     tailActive = false;
  float    env        = 0.0f;

  float x1=0,x2=0,y1=0,y2=0;

  for(uint32_t i=0;i<TABLE_SZ;++i){
    if(i == nextOn && current < BURSTS){
      if(current < BURSTS - 1){
        gateOn  = true;
        nextOff = i + BURST_LEN;
      } else {
        tailActive = true;
        env = 1.0f;
      }
      current++;
      nextOn += PULSE_INTERVAL;
    }

    if(gateOn && i >= nextOff) gateOn = false;

    float curEnv = 0.0f;
    if(gateOn)           curEnv = 1.0f;
    else if(tailActive){ curEnv = powf(env, DECAY_CURVE); env *= expK; }

    float x0 = noiseTbl[i] * curEnv * volFactor;

    float y0 = b0*x0 + b1*x1 + b2*x2 - a1*y1 - a2*y2;
    x2 = x1; x1 = x0; y2 = y1; y1 = y0;

    float fade = 1.0f;
    if(i < FADE_IN_SMP)                      fade = i / float(FADE_IN_SMP);
    else if(i > TABLE_SZ - FADE_OUT_SMP - 1) fade = (TABLE_SZ - i - 1) / float(FADE_OUT_SMP);
    y0 *= fade;

    dst[i] = int16_t(constrain(y0, -1.0f, 1.0f) * PWM_MID * MASTER_ATTEN);
  }
}

/**********************  === PWM ISR ===  *************************************/
// Audio only — no LED code in here
void on_pwm_wrap(){
  pwm_clear_irq(sliceIRQ);

  if(!playingClap){
    pwm_set_chan_level(sliceAudio, PWM_CHAN_B, uint16_t(PWM_MID));
    return;
  }

  int32_t mix = outClap[idxClap];
  int32_t val = PWM_MID + int32_t(mix * AMP_SCALE);
  if(val < 0) val = 0; else if(val > 1023) val = 1023;
  pwm_set_chan_level(sliceAudio, PWM_CHAN_B, uint16_t(val));

  idxClap++;
  if(idxClap >= TABLE_SZ){
    playingClap = false;
    idxClap     = 0;
  }
}

/**********************  === ISRs ===  ****************************************/
void triggerISR(){
  volFactor = digitalRead(0) ? 0.5f : 1.0f;
  reqTrig   = true;
}

void manualButtonISR(){
  volFactor = digitalRead(0) ? 0.5f : 1.0f;
  reqTrig   = true;
}

/**********************  === SETUP ===  ***************************************/
void setup(){
  analogReadResolution(ADC_RES_BITS);
  randomSeed(analogRead(26));
  generateWhiteNoise();

  // ── WS2812B init ──────────────────────────────────────────────────────────
  led.begin();
  led.setBrightness(180);
  led.clear();
  led.show();
  // ──────────────────────────────────────────────────────────────────────────

  pinMode(1, OUTPUT); gpio_set_function(1, GPIO_FUNC_PWM);
  sliceAudio = pwm_gpio_to_slice_num(1);
  pwm_set_clkdiv(sliceAudio, 1);
  pwm_set_wrap(sliceAudio, 1023);
  pwm_set_enabled(sliceAudio, true);

  pinMode(2, OUTPUT); gpio_set_function(2, GPIO_FUNC_PWM);
  sliceIRQ = pwm_gpio_to_slice_num(2);
  pwm_set_clkdiv(sliceIRQ, 1);
  pwm_set_wrap(sliceIRQ, 4095);
  pwm_set_enabled(sliceIRQ, true);

  pwm_clear_irq(sliceIRQ);
  pwm_set_irq_enabled(sliceIRQ, true);
  irq_set_exclusive_handler(PWM_IRQ_WRAP, on_pwm_wrap);
  irq_set_enabled(PWM_IRQ_WRAP, true);

  pinMode(0, INPUT);
  pinMode(7, INPUT); attachInterrupt(digitalPinToInterrupt(7), triggerISR, RISING);
  pinMode(6, INPUT_PULLUP); attachInterrupt(digitalPinToInterrupt(6), manualButtonISR, FALLING);
}

/**********************  === LOOP ===  ****************************************/
void loop(){
  float rawA0 = readADC(A0) / float(ADC_MAX_VAL);
  float rawA1 = readADC(A1) / float(ADC_MAX_VAL);
  float norm2 = 1.0f - (readADC(A2) / float(ADC_MAX_VAL));

  bpfQ    = 0.5f + 3.5f * rawA0;
  decayMs = 20.0f + 180.0f * rawA1;
  fc      = 50.0f + 7950.0f * norm2;

  if(reqTrig){
    reqTrig = false;
    buildClap(outClap, decayMs, fc, bpfQ);
    idxClap     = 0;
    playingClap = true;

    // ── LED on: duration tracks decay time, color tracks BPF Fc ─────────────
    uint8_t r = uint8_t(255 * (1.0f - norm2));                // warm → 0
    uint8_t g = uint8_t(180 + 40 * norm2);                    // 180 → 220
    uint8_t b = uint8_t(80  + 175 * norm2);                   //  80 → 255
    led.setPixelColor(0, led.Color(r, g, b));
    led.show();
    ledOn    = true;
    ledOffAt = millis() + uint32_t(decayMs);
    // ─────────────────────────────────────────────────────────────────────────
  }

  // ── LED off after decay duration ─────────────────────────────────────────
  if(ledOn && millis() >= ledOffAt){
    led.clear();
    led.show();
    ledOn = false;
  }
  // ──────────────────────────────────────────────────────────────────────────

  delayMicroseconds(500);
}
