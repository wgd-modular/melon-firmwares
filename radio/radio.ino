/*
HAGIWO MOD2 Radio Sampler Ver1.0

  • Single long-form recording, up to ~43 s at full quality or ~160 s lo-fi
  • Optimized for vocal/speech/podcast sampling for techno production
  • Variable playback speed with pitch shifting (0.5× to 1.5×)
  • Start position control for selecting different sections
  • Forward/Reverse playback direction switching
  • PWM audio output at ~36.6 kHz using 10-bit resolution
  • Linear interpolation for smooth pitch-shifting

  The recording is not part of the code. It sits in its own flash region
  (see SAMPLE_ADDR) and is put there by the web tool or by postbuild.py:
  https://wgd-modular.github.io/melon-firmwares/radio/

  --Pin assign---
POT1     A0       Playback speed control (0.5×–1.5×)
POT2     A1       Direction switch (< 512 = forward, >= 512 = reverse)
POT3     A2       Start position in sample (0-100%)
IN1      GPIO7    External trigger (rising-edge)
IN2      GPIO0    Loop mode toggle (LOW = one-shot, HIGH = loop)
CV       A2       Shared with POT3 for CV control of position
BUTTON   GPIO6    Manual trigger (active-low, pull-up)
OUT      GPIO1    10-bit PWM audio output (~36.6 kHz)
LED      GPIO5    WS2812B — green = forward, orange = reverse, white flash on trigger (80 ms),
                  slow red pulse = no recording in flash
EEPROM   N/A

CC0 1.0 Universal (CC0 1.0) Public Domain Dedication
You can copy, modify, distribute and perform the work, even for commercial purposes, all without asking permission.

Most of the source code was generated by AI.
Although the code has been tested, it may still exhibit unstable behavior or contain incorrect comments.
*/

#include <Arduino.h>
#include "hardware/pwm.h"
#include "hardware/irq.h"
#include "hardware/clocks.h"

// ── WS2812B ───────────────────────────────────────────────────────────────────
#include <Adafruit_NeoPixel.h>
#define LED_PIN   5
#define LED_COUNT 1
Adafruit_NeoPixel led(LED_COUNT, LED_PIN, NEO_GRB + NEO_KHZ800);

bool     ledTrigOn    = false;
uint32_t ledTrigOffAt = 0;
// ──────────────────────────────────────────────────────────────────────────────

// ── Recording in flash ────────────────────────────────────────────────────────
// A 256-byte header followed by the sample data. The region ends where the
// EEPROM emulation starts. Keep these in sync with postbuild.py and web/uf2.js.
#define SAMPLE_ADDR   (XIP_BASE + 0x020000)
#define SAMPLE_END    (XIP_BASE + 0x1FE000)
#define SAMPLE_MAGIC  0x4F494452UL  // "RDIO"
#define HEADER_SIZE   256

enum : uint8_t { FORMAT_PCM10 = 1, FORMAT_ULAW = 2 };

struct SampleHeader {
  uint32_t magic;
  uint16_t version;
  uint8_t  format;
  uint8_t  reserved;
  uint32_t rate;
  uint32_t length;
  char     name[48];
};

const uint8_t* sampleData   = nullptr;
uint32_t       sampleLength = 0;
uint8_t        sampleFormat = 0;
float          rateScale    = 1.0f;
int16_t        ulawTable[256];
// ──────────────────────────────────────────────────────────────────────────────

#define FRAC_BITS    10
#define FRAC_MASK    ((1UL << FRAC_BITS) - 1)

const uint16_t PWM_FS   = 1023;
const uint16_t PWM_MID  = PWM_FS / 2;
const uint16_t PWM_WRAP = 4095;

volatile bool     playing      = false;
volatile uint32_t tblAcc       = 0;
volatile uint32_t tblStepFP    = 1UL << FRAC_BITS;
volatile bool     isReverse    = false;
volatile bool     loopMode     = false;
volatile uint32_t startPos16   = 0;
volatile uint32_t endPos16     = 0;

uint sliceAudio, sliceIRQ;

inline int16_t sampleAt(uint32_t idx) {
  if (sampleFormat == FORMAT_ULAW) return ulawTable[sampleData[idx]];
  // 10-bit samples packed back to back, least significant bits first
  uint32_t bit = idx * 10;
  const uint8_t* p = sampleData + (bit >> 3);
  uint32_t v = ((p[0] | (p[1] << 8)) >> (bit & 7)) & 0x3FF;
  return int16_t((v << 6) - 32768);
}

bool loadSample() {
  const SampleHeader* h = (const SampleHeader*)SAMPLE_ADDR;
  if (h->magic != SAMPLE_MAGIC || h->version != 1) return false;
  if (h->rate < 1000 || h->rate > 96000 || h->length < 2) return false;

  uint32_t bytes;
  if (h->format == FORMAT_PCM10)     bytes = (h->length * 10 + 7) / 8;
  else if (h->format == FORMAT_ULAW) bytes = h->length;
  else return false;
  if (h->length > SAMPLE_END - SAMPLE_ADDR || bytes > SAMPLE_END - SAMPLE_ADDR - HEADER_SIZE) return false;

  for (int i = 0; i < 256; i++) {
    uint8_t u = ~i;
    int t = (((u & 0x0F) << 3) + 0x84) << ((u & 0x70) >> 4);
    ulawTable[i] = (u & 0x80) ? (0x84 - t) : (t - 0x84);
  }

  sampleData   = (const uint8_t*)(SAMPLE_ADDR + HEADER_SIZE);
  sampleLength = h->length;
  sampleFormat = h->format;
  rateScale    = float(h->rate) * (PWM_WRAP + 1) / float(clock_get_hz(clk_sys));
  return true;
}

// PWM ISR — audio only
void on_pwm_wrap() {
  pwm_clear_irq(sliceIRQ);

  if (!playing) {
    pwm_set_chan_level(sliceAudio, PWM_CHAN_B, PWM_MID);
    return;
  }

  uint32_t idx  = tblAcc >> FRAC_BITS;
  uint32_t frac = tblAcc & FRAC_MASK;

  if (!isReverse) {
    if (idx >= endPos16) {
      if (loopMode) {
        tblAcc = startPos16 << FRAC_BITS;
      } else {
        playing = false;
        tblAcc  = startPos16 << FRAC_BITS;
        pwm_set_chan_level(sliceAudio, PWM_CHAN_B, PWM_MID);
        return;
      }
    }
  } else {
    if (idx <= startPos16 || idx >= sampleLength) {
      if (loopMode) {
        tblAcc = (endPos16 - 1) << FRAC_BITS;
      } else {
        playing = false;
        tblAcc  = startPos16 << FRAC_BITS;
        pwm_set_chan_level(sliceAudio, PWM_CHAN_B, PWM_MID);
        return;
      }
    }
  }

  idx  = tblAcc >> FRAC_BITS;
  frac = tblAcc & FRAC_MASK;

  int16_t s1 = sampleAt(idx);
  int16_t s2;
  if (!isReverse) {
    s2 = (idx + 1 < endPos16)   ? sampleAt(idx + 1) : 0;
  } else {
    s2 = (idx > startPos16)     ? sampleAt(idx - 1) : 0;
  }

  int32_t mix          = ((int32_t)s1 * (int32_t)((1UL<<FRAC_BITS) - frac) + (int32_t)s2 * (int32_t)frac) >> FRAC_BITS;
  int16_t interpolated = int16_t(mix);
  uint16_t pwmVal      = uint16_t(int32_t(interpolated) + 32768) >> 6;
  pwm_set_chan_level(sliceAudio, PWM_CHAN_B, pwmVal);

  if (!isReverse) {
    tblAcc += tblStepFP;
  } else {
    if (tblAcc >= tblStepFP) {
      tblAcc -= tblStepFP;
    } else {
      tblAcc = startPos16 << FRAC_BITS;
      if (loopMode) {
        tblAcc = (endPos16 - 1) << FRAC_BITS;
      } else {
        playing = false;
      }
    }
  }
}

void onTrigger() {
  if (sampleLength == 0) return;

  playing = false;

  uint16_t posVal       = 1023 - analogRead(A2);
  uint32_t startPercent = (uint32_t)posVal * 100UL / 1023UL;
  startPos16            = (sampleLength * startPercent) / 100UL;
  endPos16              = sampleLength;

  if (!isReverse) {
    tblAcc = startPos16 << FRAC_BITS;
  } else {
    tblAcc = (endPos16 - 1) << FRAC_BITS;
  }

  // ── White flash 80 ms, then restore direction color in loop() ─────────────
  led.setPixelColor(0, led.Color(255, 255, 255));
  led.show();
  ledTrigOn    = true;
  ledTrigOffAt = millis() + 80;
  // ──────────────────────────────────────────────────────────────────────────

  playing = true;
}

void setup() {
  analogReadResolution(10);

  pinMode(0, INPUT);

  bool hasSample = loadSample();

  // ── WS2812B init (replaces pinMode(5,OUTPUT) + digitalWrite(5,LOW)) ───────
  led.begin();
  led.setBrightness(180);
  led.setPixelColor(0, hasSample ? led.Color(0, 255, 80) : led.Color(0, 0, 0));  // boot: green (forward default)
  led.show();
  // ──────────────────────────────────────────────────────────────────────────

  pinMode(1, OUTPUT); gpio_set_function(1, GPIO_FUNC_PWM);
  pinMode(2, OUTPUT); gpio_set_function(2, GPIO_FUNC_PWM);
  sliceAudio = pwm_gpio_to_slice_num(1);
  sliceIRQ   = pwm_gpio_to_slice_num(2);

  pwm_set_clkdiv(sliceAudio, 150000000.0f / (96000.0f * 1024.0f)); pwm_set_wrap(sliceAudio, PWM_FS);   pwm_set_enabled(sliceAudio, true);
  pwm_set_clkdiv(sliceIRQ,   1); pwm_set_wrap(sliceIRQ,   PWM_WRAP); pwm_set_enabled(sliceIRQ,   true);
  pwm_clear_irq(sliceIRQ);
  pwm_set_irq_enabled(sliceIRQ, true);
  irq_set_exclusive_handler(PWM_IRQ_WRAP, on_pwm_wrap);
  irq_set_enabled(PWM_IRQ_WRAP, true);

  pinMode(7, INPUT);
  attachInterrupt(digitalPinToInterrupt(7), onTrigger, RISING);
  pinMode(6, INPUT_PULLUP);
  attachInterrupt(digitalPinToInterrupt(6), onTrigger, FALLING);
}

void loop() {
  if (sampleLength == 0) {
    // No recording in flash: pulse red slowly
    uint32_t phase = (millis() / 8) % 512;
    uint8_t level  = phase < 256 ? phase : 511 - phase;
    led.setPixelColor(0, led.Color(level, 0, 0));
    led.show();
    delay(20);
    return;
  }

  uint16_t raw = analogRead(A0);
  float rate   = 0.5f + (raw / 1023.0f);
  tblStepFP    = uint32_t(rate * rateScale * float(1 << FRAC_BITS));

  uint16_t dirVal = analogRead(A1);
  bool newReverse = (dirVal >= 512);
  if (newReverse != isReverse) {
    isReverse = newReverse;
    // Clamp accumulator into valid range to prevent underflow after flip
    if (playing) {
      uint32_t idx = tblAcc >> FRAC_BITS;
      if (!isReverse && idx >= endPos16 && endPos16 > 0) {
        tblAcc = (endPos16 - 1) << FRAC_BITS;
      } else if (isReverse && idx <= startPos16) {
        tblAcc = (startPos16 + 1) << FRAC_BITS;
      }
    }
  }

  loopMode = (digitalRead(0) == HIGH);

  if (ledTrigOn && millis() >= ledTrigOffAt) {
    led.setPixelColor(0, isReverse ? led.Color(255, 100, 0) : led.Color(0, 255, 80));
    led.show();
    ledTrigOn = false;
  }

  static bool lastReverse = false;
  if (!ledTrigOn && isReverse != lastReverse) {
    lastReverse = isReverse;
    led.setPixelColor(0, isReverse ? led.Color(255, 100, 0) : led.Color(0, 255, 80));
    led.show();
  }

  delay(5);
}
