/*
HAGIWO MOD2 VCO Ver1.0

• Six discrete waveforms, chosen by POT 1 (A0) and switched by fixed ADC thresholds 
 0 – Sine | 1 – Triangle | 2 – Square (PolyBLEP) | 3 – Saw (PolyBLEP) | 4 – FM-4× | 5 – FM-2×
• PolyBLEP anti-aliasing on every hard-edge waveform (Square, Saw, both FM modes)
• Additional 1-pole RC low-pass filter softens residual PWM / alias noise
• Coarse tuning via POT 2 (A1); negative-slope 1 V/Oct CV on A2
• TUNE_CAL compile-time constant (default = 1.000) multiplies the final frequency for easy front-panel calibration
• Octave-shift push-button (GPIO 6) cycles through 0 / +1 / +2 / +3 octaves
• FM depth set by fmAmount (radians) in the source; no CV assignment
• 10-bit PWM audio (GPIO 1, channel B) at ≃36.6 kHz ISR rate
• Wavetable resolution 1 024 samples with linear interpolation
• ISR-driven; second PWM slice (GPIO 2) only generates periodic interrupts

  --Pin assign---
POT1     A0       Waveform select (Sin / Tri / Squ / Saw / FM-4× / FM-2×)
POT2     A1       Coarse tune
POT3     A2       Frequency
IN1      GPIO7    N/A
IN2      GPIO0    N/A
CV       A2       V/oct (Shared with POT3)
BUTTON   GPIO6    Change octave 0, +1, +2, +3
OUT      GPIO1    10-bit PWM audio output (~36.6 kHz)
LED      GPIO5    WS2812B — color = waveform (Sine/Tri/Square/Saw/FM-4×/FM-2×)
EEPROM   N/A

CC0 1.0 Universal (CC0 1.0) Public Domain Dedication
You can copy, modify, distribute and perform the work, even for commercial purposes, all without asking permission.

Most of the source code was generated by AI.
Although the code has been tested, it may still exhibit unstable behavior or contain incorrect comments.
*/

#include <Arduino.h>
#include "hardware/pwm.h"
#include "hardware/irq.h"
#include <math.h>

// ── WS2812B ───────────────────────────────────────────────────────────────────
#include <Adafruit_NeoPixel.h>
#define LED_PIN   5
#define LED_COUNT 1
Adafruit_NeoPixel led(LED_COUNT, LED_PIN, NEO_GRB + NEO_KHZ800);

// One color per waveform index 0–5
const uint32_t WAVE_COLORS[6] = {
  0x0080FF,   // 0 Sine     — soft blue (smooth, pure)
  0x00FF80,   // 1 Triangle — mint green (gentle, ramp-like)
  0xFF2000,   // 2 Square   — red-orange (hard, digital)
  0xFF8000,   // 3 Saw      — amber (bright, buzzy)
  0xCC00FF,   // 4 FM 4×    — purple (complex, metallic)
  0xFF00AA,   // 5 FM 2×    — hot pink (warm FM)
};
// ──────────────────────────────────────────────────────────────────────────────

/* ============================== constants ============================== */
constexpr int   TABLE_SIZE    = 1024;
constexpr float FULL_SCALE    = 1023.0f;
constexpr float MID_LEVEL     = FULL_SCALE / 2.0f;

constexpr float SYS_CLK       = 150'000'000.0f;
constexpr int   PWM_WRAP_IRQ  = 4095;

constexpr float TUNE_MIN_HZ   = 320.0f;
constexpr float TUNE_RANGE_HZ =  90.0f;

const float TUNE_CAL          = 0.992f;
constexpr float LP_ALPHA      = 0.18f;

volatile float fmAmount       = 2.0f;

/* ========================== hardware globals =========================== */
uint sliceAudio;
uint sliceIRQ;

volatile uint16_t pwmSample = 0;
volatile float    phase     = 0.0f;
volatile float    phaseStep = 0.0f;
float             sampleRate = 0.0f;

/* ============================ wavetable =============================== */
float tableSin[TABLE_SIZE];
float tableTri[TABLE_SIZE];

volatile uint8_t waveSel  = 0;
volatile uint8_t octShift = 0;

/* -----------------------------------------------------------------------
 *  PolyBLEP helper
 * -------------------------------------------------------------------- */
inline float polyBLEP(float t, float dt)
{
  if (t < dt)        { float x = t / dt;          return x + x - x*x - 1.0f; }
  if (t > 1.0f - dt) { float x = (t - 1.0f) / dt; return x*x + x + x + 1.0f; }
  return 0.0f;
}

/* -----------------------------------------------------------------------
 *  Build sine & triangle tables
 * -------------------------------------------------------------------- */
void initTables()
{
  for (int i = 0; i < TABLE_SIZE; ++i) {
    tableSin[i] = MID_LEVEL + MID_LEVEL * sinf(2.0f * PI * i / TABLE_SIZE);
    if (i < TABLE_SIZE / 2)
      tableTri[i] = FULL_SCALE * i / ((TABLE_SIZE / 2) - 1);
    else
      tableTri[i] = FULL_SCALE * (TABLE_SIZE - 1 - i) / ((TABLE_SIZE / 2) - 1);
  }
}

/* =======================================================================
 *  PWM ISR — untouched
 * ==================================================================== */
void __isr onPwmWrap()
{
  const int   idx     = static_cast<int>(phase) & (TABLE_SIZE - 1);
  const int   idxNext = (idx + 1) & (TABLE_SIZE - 1);
  const float frac    = phase - idx;
  const float tNorm   = phase / TABLE_SIZE;
  const float dtNorm  = phaseStep / TABLE_SIZE;

  float sample = MID_LEVEL;

  switch (waveSel)
  {
    case 0: {
      sample = tableSin[idx] * (1.0f - frac) + tableSin[idxNext] * frac;
      break;
    }
    case 1: {
      sample = tableTri[idx] * (1.0f - frac) + tableTri[idxNext] * frac;
      break;
    }
    case 2: {
      float s = (tNorm < 0.5f) ? 1.0f : -1.0f;
      s +=  polyBLEP(tNorm, dtNorm);
      s -=  polyBLEP(fmodf(tNorm + 0.5f, 1.0f), dtNorm);
      sample = MID_LEVEL + MID_LEVEL * s;
      break;
    }
    case 3: {
      float s = 2.0f * tNorm - 1.0f;
      s -= polyBLEP(tNorm, dtNorm);
      sample = MID_LEVEL + MID_LEVEL * s;
      break;
    }
    case 4: {
      float tMod  = fmodf(tNorm * 4.0f, 1.0f);
      float posM  = tMod * TABLE_SIZE;
      int   idxM  = static_cast<int>(posM) & (TABLE_SIZE - 1);
      int   idxMN = (idxM + 1) & (TABLE_SIZE - 1);
      float fracM = posM - idxM;
      float modVal = tableSin[idxM] * (1.0f - fracM) + tableSin[idxMN] * fracM;
      float modN   = (modVal - MID_LEVEL) / MID_LEVEL;
      float phaseRad = 2.0f * PI * tNorm + fmAmount * modN;
      sample = MID_LEVEL + MID_LEVEL * sinf(phaseRad);
      break;
    }
    default: {
      float tMod  = fmodf(tNorm * 2.0f, 1.0f);
      float posM  = tMod * TABLE_SIZE;
      int   idxM  = static_cast<int>(posM) & (TABLE_SIZE - 1);
      int   idxMN = (idxM + 1) & (TABLE_SIZE - 1);
      float fracM = posM - idxM;
      float modVal = tableSin[idxM] * (1.0f - fracM) + tableSin[idxMN] * fracM;
      float modN   = (modVal - MID_LEVEL) / MID_LEVEL;
      float phaseRad = 2.0f * PI * tNorm + fmAmount * modN;
      sample = MID_LEVEL + MID_LEVEL * sinf(phaseRad);
      break;
    }
  }

  static float lpState = MID_LEVEL;
  lpState += (sample - lpState) * LP_ALPHA;
  sample = lpState;

  pwmSample = static_cast<uint16_t>(sample + 0.5f);
  pwm_set_chan_level(sliceAudio, PWM_CHAN_B, pwmSample);

  phase += phaseStep;
  if (phase >= TABLE_SIZE) phase -= TABLE_SIZE;

  pwm_clear_irq(sliceIRQ);
}

/* =======================================================================
 *  Setup
 * ==================================================================== */
void setup()
{
  pinMode(A0, INPUT);
  pinMode(A1, INPUT);
  pinMode(A2, INPUT);
  pinMode(6, INPUT_PULLUP);

  pinMode(1, OUTPUT);
  gpio_set_function(1, GPIO_FUNC_PWM);
  sliceAudio = pwm_gpio_to_slice_num(1);
  pwm_set_clkdiv(sliceAudio, 1);
  pwm_set_wrap  (sliceAudio, 1023);
  pwm_set_enabled(sliceAudio, true);

  gpio_set_function(2, GPIO_FUNC_PWM);
  sliceIRQ = pwm_gpio_to_slice_num(2);
  pwm_clear_irq(sliceIRQ);
  pwm_set_irq_enabled(sliceIRQ, true);
  irq_set_exclusive_handler(PWM_IRQ_WRAP, onPwmWrap);
  irq_set_enabled(PWM_IRQ_WRAP, true);
  pwm_set_clkdiv(sliceIRQ, 1);
  pwm_set_wrap  (sliceIRQ, PWM_WRAP_IRQ);
  pwm_set_enabled(sliceIRQ, true);

  sampleRate = SYS_CLK / (PWM_WRAP_IRQ + 1);
  initTables();

  // ── WS2812B init ──────────────────────────────────────────────────────────
  led.begin();
  led.setBrightness(180);
  led.setPixelColor(0, WAVE_COLORS[0]);  // boot: sine = soft blue
  led.show();
  // ──────────────────────────────────────────────────────────────────────────
}

/* =======================================================================
 *  Main loop
 * ==================================================================== */
void loop()
{
  /* --- A0 : wave select --------------------------------------------- */
  const int a0 = analogRead(A0);
  uint8_t newWave;
  if      (a0 <  32) newWave = 0;
  else if (a0 < 248) newWave = 1;
  else if (a0 < 514) newWave = 2;
  else if (a0 < 720) newWave = 3;
  else if (a0 < 926) newWave = 4;
  else                newWave = 5;

  // ── Update LED color when waveform changes ────────────────────────────────
  if (newWave != waveSel) {
    waveSel = newWave;
    led.setPixelColor(0, WAVE_COLORS[waveSel]);
    led.show();
  }
  // ──────────────────────────────────────────────────────────────────────────

  /* --- A1 : base frequency ------------------------------------------ */
  const float baseFreq =
      TUNE_MIN_HZ + TUNE_RANGE_HZ * analogRead(A1) / 1023.0f;

  /* --- A2 : external CV --------------------------------------------- */
  const float cvOct =
      -(analogRead(A2) / 1023.0f) * 8.3f * (33.0f / 55.0f) * TUNE_CAL;

  /* --- push-button : octave shift ------------------------------------ */
  static int lastBtn = HIGH;
  int btn = digitalRead(6);
  if (lastBtn == HIGH && btn == LOW)
    octShift = (octShift + 1) & 3;
  lastBtn = btn;

  /* --- final frequency ---------------------------------------------- */
  float freq = baseFreq * powf(2.0f, octShift + cvOct);

  /* --- phase step ---------------------------------------------------- */
  phaseStep = freq * TABLE_SIZE / sampleRate;
}
