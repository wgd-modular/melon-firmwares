/*
HAGIWO MOD2 Claves Ver1.1 - With LED envelope display
A simple claves sound source. The waveform mixes sine and triangle waves at an arbitrary rate.
The pitch CV follows the V/oct.
LED lights on trigger for decay duration, color = pitch (green = low, red = high)

--Pin assign---
POT1     A0       Decay
POT2     A1       waveform sin<->tri
POT3     A2       Pitch
IN1      GPIO7    Trig in
IN2      GPIO0    N/A
CV       A2       Shared with POT3
OUT      GPIO1    Audio output
BUTTON   GPIO6    Manual Trig
LED      GPIO5    WS2812B — on for decay duration, color = pitch (green → red)
EEPROM    N/A


CC0 1.0 Universal (CC0 1.0) Public Domain Dedication
You can copy, modify, distribute and perform the work, even for commercial purposes, all without asking permission.

Most of the source code was generated by AI.
Although the code has been tested, it may still exhibit unstable behavior or contain incorrect comments.

*/

#include <Arduino.h>
#include "hardware/pwm.h"
#include "hardware/irq.h"
#include <math.h>

// ── WS2812B ───────────────────────────────────────────────────────────────────
#include <Adafruit_NeoPixel.h>
#define LED_PIN   5
#define LED_COUNT 1
Adafruit_NeoPixel led(LED_COUNT, LED_PIN, NEO_GRB + NEO_KHZ800);

bool     ledOn    = false;
uint32_t ledOffAt = 0;
// ──────────────────────────────────────────────────────────────────────────────

/* ============================================================ */
/* ★ Basic constants                                            */
/* ============================================================ */
const float   SYS_CLOCK   = 150000000.0f;
const uint16_t TABLE_SZ   = 8192;
const uint8_t  LUT_SZ     = 64;
#define        LUT_MASK   (LUT_SZ - 1)

const float PWM_FS  = 1023.0f;
const float PWM_MID = PWM_FS / 2.0f;

const float AUDIO_FS = SYS_CLOCK / 4096.0f;
const float PH_INC_K = float(LUT_SZ) / AUDIO_FS;

#define  ADC_RES_BITS 10
#define  ADC_MAX_VAL  ((1 << ADC_RES_BITS) - 1)
#define  ADC_AVG_CNT  16

const float CV_FULL_V    = 5.0f;
const float PITCH_F0     = 50.0f;
const float PITCH_MAX_HZ = 1500.0f;

/* ============================================================ */
/* ★ Global variables                                           */
/* ============================================================ */
float sineLUT[LUT_SZ];
float triLUT [LUT_SZ];

uint16_t finalTbl[TABLE_SZ];

volatile bool     playing  = false;
volatile uint16_t tblIdx   = 0;

volatile float decayRate = 5.0f;
volatile float waveMorph = 0.0f;

// decay time in ms, set on trigger, read in loop for LED duration
volatile float decayDurMs = 100.0f;

uint sliceAudio, sliceIRQ;   // LED slice removed

/* ============================================================ */
/* ★ Read ADC with 16‑sample averaging                          */
/* ============================================================ */
inline uint16_t readAnalogAvg(uint8_t pin) {
  uint32_t sum = 0;
  for (int i = 0; i < ADC_AVG_CNT; ++i) sum += analogRead(pin);
  return uint16_t(sum / ADC_AVG_CNT);
}

/* ============================================================ */
/* ★ PWM‑wrap ISR  — audio only, no LED code                    */
/* ============================================================ */
void on_pwm_wrap() {
  pwm_clear_irq(sliceIRQ);

  if (!playing) {
    pwm_set_chan_level(sliceAudio, PWM_CHAN_B, uint16_t(PWM_MID));
    return;
  }

  pwm_set_chan_level(sliceAudio, PWM_CHAN_B, finalTbl[tblIdx]);

  if (++tblIdx >= TABLE_SZ) {
    playing = false;
    tblIdx  = 0;
  }
}

/* ============================================================ */
/* ★ Trigger ISR                                                */
/* ============================================================ */
void onTrigger() {
  playing = false;
  irq_set_enabled(PWM_IRQ_WRAP, false);

  delay(5);

  decayRate = 1.0f + 9.0f * (analogRead(A0) / 1023.0f);
  waveMorph =               analogRead(A1) / 1023.0f;

  uint16_t adc   = ADC_MAX_VAL - readAnalogAvg(A2);
  float cvV      = (adc / float(ADC_MAX_VAL)) * CV_FULL_V;
  float baseFreq = PITCH_F0 * powf(2.0f, cvV);
  if (baseFreq > PITCH_MAX_HZ) baseFreq = PITCH_MAX_HZ;

  // Normalised pitch 0.0 (low) → 1.0 (high) for LED color
  float pitchNorm = float(adc) / float(ADC_MAX_VAL);

  // Approximate decay duration in ms for LED (decay curve 1–10 mapped to ~200–20 ms)
  decayDurMs = 200.0f / decayRate;

  const float invN  = 1.0f / (TABLE_SZ - 1);
  const float expK  = expf(-decayRate * invN);
  float env         = 1.0f;

  const float phInc = baseFreq * PH_INC_K;
  float ph          = 0.0f;

  const uint16_t fadeStart  = uint16_t(TABLE_SZ * 0.95f);
  const uint16_t fadeLen    = TABLE_SZ - 1 - fadeStart;
  const float    invFadeLen = 1.0f / fadeLen;

  for (uint16_t i = 0; i < TABLE_SZ; ++i) {
    uint8_t idx  = uint8_t(ph) & LUT_MASK;
    uint8_t idx2 = (idx + 1) & LUT_MASK;
    float   frac = ph - uint8_t(ph);

    float s = sineLUT[idx] * (1 - frac) + sineLUT[idx2] * frac;
    float t =  triLUT[idx] * (1 - frac) +  triLUT[idx2] * frac;
    float w = s * (1 - waveMorph) + t * waveMorph;

    float y = w * env;
    env *= expK;

    if (i >= fadeStart) {
      float mu  = (i - fadeStart) * invFadeLen;
      float mu2 = 0.5f * (1 - cosf(mu * PI));
      y *= (1 - mu2);
    }

    finalTbl[i] = uint16_t((y + 1.0f) * (PWM_FS / 2.0f));

    ph += phInc;
    if (ph >= LUT_SZ) ph -= LUT_SZ;
  }

  // ── LED on: color = pitch (green low → red high) ──────────────────────────
  uint8_t r = uint8_t(255 * pitchNorm);          //   0 → 255
  uint8_t g = uint8_t(255 * (1.0f - pitchNorm)); // 255 → 0
  uint8_t b = 0;
  led.setPixelColor(0, led.Color(r, g, b));
  led.show();
  ledOn    = true;
  ledOffAt = millis() + uint32_t(decayDurMs);
  // ──────────────────────────────────────────────────────────────────────────

  tblIdx  = 0;
  playing = true;
  irq_set_enabled(PWM_IRQ_WRAP, true);
}

/* ============================================================ */
/* ★ SETUP                                                      */
/* ============================================================ */
void setup() {
  analogReadResolution(ADC_RES_BITS);

  for (uint8_t i = 0; i < LUT_SZ; ++i) {
    float th   = 2.0f * PI * i / LUT_SZ;
    sineLUT[i] = sinf(th);
    triLUT[i]  = (2.0f / PI) * asinf(sineLUT[i]);
  }

  // ── WS2812B init ──────────────────────────────────────────────────────────
  led.begin();
  led.setBrightness(180);
  led.clear();
  led.show();
  // ──────────────────────────────────────────────────────────────────────────

  pinMode(1, OUTPUT);
  gpio_set_function(1, GPIO_FUNC_PWM);
  sliceAudio = pwm_gpio_to_slice_num(1);
  pwm_set_clkdiv(sliceAudio, 1);
  pwm_set_wrap  (sliceAudio, 1023);
  pwm_set_enabled(sliceAudio, true);

  pinMode(2, OUTPUT);
  gpio_set_function(2, GPIO_FUNC_PWM);
  sliceIRQ = pwm_gpio_to_slice_num(2);
  pwm_set_clkdiv(sliceIRQ, 1);
  pwm_set_wrap  (sliceIRQ, 4095);
  pwm_set_enabled(sliceIRQ, true);
  pwm_clear_irq     (sliceIRQ);
  pwm_set_irq_enabled(sliceIRQ, true);
  irq_set_exclusive_handler(PWM_IRQ_WRAP, on_pwm_wrap);
  irq_set_enabled(PWM_IRQ_WRAP, true);

  pinMode(7, INPUT);
  attachInterrupt(digitalPinToInterrupt(7), onTrigger, RISING);
  pinMode(6, INPUT_PULLUP);
  attachInterrupt(digitalPinToInterrupt(6), onTrigger, FALLING);
}

/* ============================================================ */
/* ★ Main loop — LED off timer only                             */
/* ============================================================ */
void loop() {
  // ── LED off after decay duration ─────────────────────────────────────────
  if (ledOn && millis() >= ledOffAt) {
    led.clear();
    led.show();
    ledOn = false;
  }
  // ──────────────────────────────────────────────────────────────────────────
}
